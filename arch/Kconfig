## arch/Kconfig
```kconfig
config HAVE_CLK
	default n
	bool
	help
	  The <linux/clk.h> calls support software clock gating and
	  thus are a key power management tool on many systems.

source "kernel/gcov/Kconfig"
```
